## boards/shields/Dactyl_Manuform/Kconfig.shield
```kconfig
config SHIELD_DACTYL_MANUFORM_LEFT
    def_bool $(shirlds_list_contains,dactyl_manuform_left)

config SHIELD_DACTYL_MANUFORM_RIGHT
    def_bool $(shirlds_list_contains,dactyl_manuform_right)
```
